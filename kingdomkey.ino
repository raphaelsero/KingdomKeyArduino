#include <PCM.h>
int blue_pin = 7;
int green_pin = 4;
int red_pin = 2;
int count = 0;


const unsigned char sample[] PROGMEM = {
126, 128, 129, 128, 127, 126, 129, 127, 128, 127, 127, 129,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 127, 
};

const unsigned char heal[] PROGMEM = {
  126, 128, 127, 127, 127, 127, 127, 128, 129, 127, 128, 128,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 128, 
  };

const unsigned char fire[] PROGMEM = {
  129, 127, 127, 128, 127, 127, 128, 128, 128, 127, 127, 128,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 127, 
  };

const unsigned char freeze[] PROGMEM = {
130, 126, 127, 128, 127, 127, 128, 128, 128, 127, 127, 128,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 127,   
};

const unsigned char thunder[] PROGMEM = {
  129, 127, 127, 127, 128, 127, 127, 128, 128, 128, 127, 128,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 127, 

  };


void setup()
{
  pinMode(red_pin, OUTPUT);
  pinMode(green_pin, OUTPUT);
  pinMode(blue_pin, OUTPUT);
  pinMode(9, OUTPUT);
  Serial.begin(9600);
}

void loop()
{
  Serial.println(count);
  int buttonState = digitalRead(12);
  int buttonState2 = digitalRead(8);
  int sensorValue = analogRead(A0);
  countManager();
  mainButton(buttonState, buttonState2);
  accentButton(buttonState, buttonState2);
  bothPressed(buttonState, buttonState2);
  Serial.println(sensorValue);
  delay(1);
}
void bothPressed(int buttonState, int buttonState2){
  if(buttonState == 1 && buttonState2 == 1){
    digitalWrite(9, HIGH);
    }
    else {
      digitalWrite(9, LOW);
      }
  
  }

  
void countManager(){
  if(count == 5) {
      count = 0;
      }

  if(count == 4) {
      turnOffLed();
      count = 4;
      Serial.print(count);
      Serial.print("Attack");
      }

      if(count == 0 ) {
      setColor(255,0,0);
      count = 0;
      Serial.print(count);
      Serial.print("Fire!");
      }

      if(count == 1) {
      setColor(0,0,255);
      count = 1;
      Serial.print(count);
      Serial.print("Freeze!");
      }

      if(count == 2) {
      setColor(255,255,0);
      count = 2;
      Serial.print(count);
      Serial.print("Thunder!");
      }

      if(count == 3) {
      setColor(0,255,0);
      count = 3;
      Serial.print(count);
      Serial.print("Heal!");
      } 
}


void mainButton(int buttonState, int buttonState2){
  if (buttonState == 1 && buttonState2 != 1)
  {  
    delay(100);
     startPlayback(sample, sizeof(sample));
     count++;
     
  }
}

void accentButton(int buttonState, int buttonState2){
    if (buttonState2 == 1 && buttonState != 1){
    if(count == 0){
      startPlayback(fire, sizeof(fire));
      delay(500);
      startPlayback(sample, sizeof(sample));
    }
    if(count == 1){
      startPlayback(freeze, sizeof(freeze));
      delay(500);
      startPlayback(sample, sizeof(sample));
    }
    if(count == 2){
      startPlayback(thunder, sizeof(thunder));
      delay(500);
      startPlayback(sample, sizeof(sample));
    }
    if(count == 3){
      startPlayback(heal, sizeof(heal));
      delay(500);
      startPlayback(sample, sizeof(sample));
    }

    if(count == 4){
      delay(500);
      startPlayback(sample, sizeof(sample));
    }
    delay(500);
    count++;
        
  }
  }
void turnOffLed(){
     digitalWrite(red_pin, LOW);
     digitalWrite(green_pin, LOW);
     digitalWrite(blue_pin, LOW);
  }
void setColor(int red, int green, int blue){
  analogWrite(red_pin, red);
  analogWrite(green_pin, green);
  analogWrite(blue_pin, blue);
  }
